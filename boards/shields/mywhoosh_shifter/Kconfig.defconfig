## boards/shields/mywhoosh_shifter/Kconfig.defconfig
```kconfig
# SPDX-License-Identifier: MIT

if SHIELD_MYWHOOSH_TWO_BUTTON || SHIELD_MYWHOOSH_FOUR_BUTTON

config ZMK_KEYBOARD_NAME
    default "MyWhooshShift"

endif
```

## boards/shields/mywhoosh_shifter/Kconfig.shield
```kconfig
# SPDX-License-Identifier: MIT

config SHIELD_MYWHOOSH_TWO_BUTTON
    def_bool $(shields_list_contains,mywhoosh_two_button)

config SHIELD_MYWHOOSH_FOUR_BUTTON
    def_bool $(shields_list_contains,mywhoosh_four_button)
```
